//USB host mouse from USB Host Shield Library. Install using Library Manager
#include <hiduniversal.h>

//USB device mouse library included with Arduino IDE 1.8.5
#include <Mouse.h>

//Satisfy the IDE, which needs to see the include statment in the ino too
#ifdef dobogusinclude
#include <spi4teensy3.h>
#endif
#include <SPI.h>

//Variables
bool autoClickMode = false;

const PROGMEM uint8_t clickTimesArray[] = { 
  104, 127, 126, 108, 117, 109, 110, 89, 103, 132, 125, 105,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 116,
  96, 92, 114, 104, 102, 107, 116, 103, 124, 106, 86, 103,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 111, 108 };
  
//Constants used to set pin numbers
const int leftPedalPin = 12;
const int rightPedalPin = 13;

const int ledPin = 13;

const int autoClickLedPin = 1;
const int leftClickLedPin = 2;
const int rightClickLedPin = 0;

const int potPin = 5;
const int maxSSPin = 11;

//Opcodes for the MAX7221 and MAX7219
const uint16_t OP_NOOP = 0;
const uint16_t OP_DIGIT0 = 1;
//Note: all OP_DIGITn are +n offsets from OP_DIGIT0
const uint16_t OP_DIGIT1 = 2;
const uint16_t OP_DIGIT2 = 3;
const uint16_t OP_DIGIT3 = 4;
const uint16_t OP_DIGIT4 = 5;
const uint16_t OP_DIGIT5 = 6;
const uint16_t OP_DIGIT6 = 7;
const uint16_t OP_DIGIT7 = 8;
const uint16_t OP_DECODEMODE = 9;
const uint16_t OP_INTENSITY = 10;
const uint16_t OP_SCANLIMIT = 11;
const uint16_t OP_SHUTDOWN = 12;
const uint16_t OP_DISPLAYTEST = 15;

int lastLeftPedalState = HIGH;  //HIGH - not pressed, LOW - pressed
uint32_t lastLeftPressTime = 0;
int lastRightPedalState = HIGH;  //HIGH - not pressed, LOW - pressed
uint32_t lastRightPressTime = 0;

bool leftPedalPressed = false;
bool rightPedalPressed = false;

//Iterator for stepping through the list of click times (for the autoclick mode)
int iterator = 0;

//The start time of when the user presses both pedals, for switching from normal mode to autoclick mode
uint32_t startSwitchTime = 0;

//Potentiometer reads
int potRead = 200;
int oldPotRead = 200;

//Speed of the autoclicking
double clickSpeed = 4.8;
const double ARRAY_CLICK_SPEED = 4.7;

class MouseRptParser : public HIDReportParser {
  public:
    virtual void Parse(USBHID *hid, bool is_rpt_id, uint8_t len, uint8_t *buf);
};

void MouseRptParser::Parse(USBHID *hid, bool is_rpt_id, uint8_t len, uint8_t *buf) {
  //Serial.println(len - 1);
  //Serial.println("");
  if (len - 1 > 3) {
    uint8_t mouseRpt[4];

    //Buttons
    mouseRpt[0] = buf[1];
    //Change the hid report if the pedals are pressed
    if (leftPedalPressed || rightPedalPressed) 
    {
      mouseRpt[0] = 0;
      if (!autoClickMode) 
      {
        if (leftPedalPressed) 
        {
          mouseRpt[0] += 1;
        }
        if (rightPedalPressed)
        {
          mouseRpt[0] += 2;
        }
      }
    }

    //X and Y
    mouseRpt[1] = buf[2];
    mouseRpt[2] = buf[3];

    //Scroll
    mouseRpt[3] = buf[4];
    
    //Send hid report
    HID().SendReport(1,mouseRpt,sizeof(mouseRpt));
  }
}

class HIDUniversalFixed : public HIDUniversal {
  public:
    HIDUniversalFixed(USB *p) : HIDUniversal(p) {}
    virtual bool BuffersIdentical(uint8_t len, uint8_t *buf1, uint8_t *buf2);
};

bool HIDUniversalFixed::BuffersIdentical(uint8_t len, uint8_t *buf1, uint8_t *buf2) {
  for(uint8_t i = 0; i < len; i++)
    if(buf1[i] != buf2[i])
      return false;
  if (buf1[4] != 0)
    return false;
  return true;
}

USB Usb;
HIDUniversalFixed Hid(&Usb);

MouseRptParser Prs;

void setup()
{
  //Initialize pins
  pinMode(leftPedalPin, INPUT);
  pinMode(rightPedalPin, INPUT);

  pinMode(ledPin, OUTPUT);

  pinMode(autoClickLedPin, OUTPUT);
  pinMode(leftClickLedPin, OUTPUT);
  pinMode(rightClickLedPin, OUTPUT);

  pinMode(maxSSPin, OUTPUT);
  digitalWrite(maxSSPin, HIGH);
  
  if (Usb.Init() == -1) {
  //  Serial.println("USB host shield did not start.");
  }

  Hid.SetReportParser(0, &Prs);

  Mouse.begin();

  delay(200);
  
  //Set up 7-segment display
  sendData(OP_SHUTDOWN, 1);
  sendData(OP_DECODEMODE, 0xFF);
  sendData(OP_SCANLIMIT, 1);
  sendData(OP_INTENSITY, 7);
  sendData(OP_DISPLAYTEST, 0);

  //Serial.begin(9600);
}

void sendData(uint16_t cmd, uint8_t data)
//Send a simple command to the MAX7219 using the hardware SPI interface
{
  uint16_t x = (cmd << 8) | data;
  SPI.beginTransaction(SPISettings(8000000, MSBFIRST, SPI_MODE0)); //8 MHz
  digitalWrite(maxSSPin, LOW);
  SPI.transfer16(x);
  digitalWrite(maxSSPin, HIGH);
  SPI.endTransaction();
}

void loop()
{
  //Handle potentiometer and 7-segment displays
  oldPotRead = potRead;
  potRead = analogRead(potPin);
  if(abs(potRead - oldPotRead) < 15) 
  {
    potRead = oldPotRead;
  }
  
  int normPotRead = min(9, (int)map(potRead, 0, 1023, 0, 10));

  //Potentiometer settings
  //4.7, 4.8, 4.9, 5.0, 5.1, 6.9, 7.0, 7.1, 11, 12
  switch(normPotRead) 
  {
    case 0:
      sendData(OP_DIGIT1, 128 + 4);
      sendData(OP_DIGIT0, 7);
      clickSpeed = 4.7;
      break;
    case 1:
      sendData(OP_DIGIT1, 128 + 4);
      sendData(OP_DIGIT0, 8);
      clickSpeed = 4.8;
      break;
    case 2:
      sendData(OP_DIGIT1, 128 + 4);
      sendData(OP_DIGIT0, 9);
      clickSpeed = 4.9;
      break;
    case 3:
      sendData(OP_DIGIT1, 128 + 5);
      sendData(OP_DIGIT0, 0);
      clickSpeed = 5.0;
      break;
    case 4:
      sendData(OP_DIGIT1, 128 + 5);
      sendData(OP_DIGIT0, 1);
      clickSpeed = 5.1;
      break;
    case 5:
      sendData(OP_DIGIT1, 128 + 6);
      sendData(OP_DIGIT0, 9);
      clickSpeed = 6.9;
      break;
    case 6:
      sendData(OP_DIGIT1, 128 + 7);
      sendData(OP_DIGIT0, 0);
      clickSpeed = 7.0;
      break;
    case 7:
      sendData(OP_DIGIT1, 128 + 7);
      sendData(OP_DIGIT0, 1);
      clickSpeed = 7.1;
      break;
    case 8:
      sendData(OP_DIGIT1, 1);
      sendData(OP_DIGIT0, 1);
      clickSpeed = 11;
      break;
    case 9:
      sendData(OP_DIGIT1, 1);
      sendData(OP_DIGIT0, 2);
      clickSpeed = 12;
      break;
  }
  
  //Handle USB clicking
  Usb.Task();
  
  uint32_t currentMillis = millis();
  
  int leftPedalState = digitalRead(leftPedalPin);
  int rightPedalState = digitalRead(rightPedalPin);

  bool switchModes = false;

  //Switching modes
  if (leftPedalState == LOW && rightPedalState == LOW) 
  {
    if ((currentMillis - startSwitchTime) >= 3000) 
    {
      autoClickMode = !autoClickMode;
      startSwitchTime = currentMillis;
      if (autoClickMode) 
      {
        digitalWrite(autoClickLedPin, HIGH);
      }
      else 
      {
        digitalWrite(autoClickLedPin, LOW);
      }
    }
  }
  else 
  {
    switchModes = false;
    startSwitchTime = currentMillis;
  }

  //Handling clicking with the two modes
  if (autoClickMode) 
  {
    if (iterator >= 3950) 
    {
      iterator = 0;
    }

    //Left click
    if (leftPedalState == LOW) 
    {
      leftPedalPressed = true;
      if (!Mouse.isPressed(MOUSE_LEFT) 
          && (currentMillis - lastLeftPressTime) >= pgm_read_byte_near(clickTimesArray + iterator) * ARRAY_CLICK_SPEED/clickSpeed) 
      {
        Mouse.press(MOUSE_LEFT);
        lastLeftPressTime = currentMillis;
        //Serial.println(pgm_read_byte_near(clickTimesArray + iterator));
        iterator++;
        digitalWrite(leftClickLedPin, HIGH);
      }
      else if ((currentMillis - lastLeftPressTime) >= pgm_read_byte_near(clickTimesArray + iterator) * ARRAY_CLICK_SPEED/clickSpeed) 
      {
        Mouse.release(MOUSE_LEFT);
        lastLeftPressTime = currentMillis;
        //Serial.println(pgm_read_byte_near(clickTimesArray + iterator));
        iterator++;
        digitalWrite(leftClickLedPin, LOW);
      }
    }
    else 
    {
      leftPedalPressed = false;

      if (Mouse.isPressed(MOUSE_LEFT) 
          && (currentMillis - lastLeftPressTime) >= pgm_read_byte_near(clickTimesArray + iterator) * ARRAY_CLICK_SPEED/clickSpeed) 
      {
        Mouse.release(MOUSE_LEFT);
        iterator++;
        digitalWrite(leftClickLedPin, LOW);
      }
    }

    //Right click
    if (rightPedalState == LOW) 
    {
      rightPedalPressed = true;
      if (!Mouse.isPressed(MOUSE_RIGHT) 
          && (currentMillis - lastRightPressTime) >= pgm_read_byte_near(clickTimesArray + iterator) * ARRAY_CLICK_SPEED/clickSpeed) 
      {
        Mouse.press(MOUSE_RIGHT);
        lastRightPressTime = currentMillis;
        iterator++;
        digitalWrite(rightClickLedPin, HIGH);
      }
      else if ((currentMillis - lastRightPressTime) >= pgm_read_byte_near(clickTimesArray + iterator) * ARRAY_CLICK_SPEED/clickSpeed) 
      {
        Mouse.release(MOUSE_RIGHT);
        lastRightPressTime = currentMillis;
        iterator++;
        digitalWrite(rightClickLedPin, LOW);
      }
    }
    else 
    {
      rightPedalPressed = false;

      if (Mouse.isPressed(MOUSE_RIGHT) 
          && (currentMillis - lastRightPressTime) >= pgm_read_byte_near(clickTimesArray + iterator) * ARRAY_CLICK_SPEED/clickSpeed) 
      {
        Mouse.release(MOUSE_RIGHT);
        iterator++;
        digitalWrite(rightClickLedPin, LOW);
      }
    }
  }
  else 
  {
    //Left click
    if (leftPedalState == LOW && !Mouse.isPressed(MOUSE_LEFT) 
        && (currentMillis - lastLeftPressTime) >= 50) 
    {
      leftPedalPressed = true;
      Mouse.press(MOUSE_LEFT);
      lastLeftPressTime = currentMillis;
      digitalWrite(leftClickLedPin, HIGH);
    }
    else if (leftPedalState == HIGH && Mouse.isPressed(MOUSE_LEFT)
             && (currentMillis - lastLeftPressTime) >= 50)
    {
      leftPedalPressed = false;
      Mouse.release(MOUSE_LEFT);
      lastLeftPressTime = currentMillis;
      digitalWrite(leftClickLedPin, LOW);
    }
  
    //Right click
    if (rightPedalState == LOW && !Mouse.isPressed(MOUSE_RIGHT) 
        && (currentMillis - lastRightPressTime) >= 50) 
    {
      rightPedalPressed = true;
      Mouse.press(MOUSE_RIGHT);
      lastRightPressTime = currentMillis;
      digitalWrite(rightClickLedPin, HIGH);
    }
    else if (rightPedalState == HIGH && Mouse.isPressed(MOUSE_RIGHT)
             && (currentMillis - lastRightPressTime) >= 50)
    {
      rightPedalPressed = false;
      Mouse.release(MOUSE_RIGHT);
      lastRightPressTime = currentMillis;
      digitalWrite(rightClickLedPin, LOW);
    }
  }
}
